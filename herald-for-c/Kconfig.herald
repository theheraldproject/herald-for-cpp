## herald-for-c/Kconfig.herald
```kconfig
# /*
#  * Copyright 2020-2021 Herald Project Contributors
#  * SPDX-License-Identifier: Apache-2.0
#  * 
#  */

menu "HERALD"
  config HERALD_PAYLOAD_READ_INTERVAL_S
  int "Payload read interval (seconds)"
  default 60
  help
    "The time that should be waited before payload is read again"
  
  config HERALD_MAX_PAYLOAD_READ_AT_ONE_TIME
  int "Maximum payloads simultaneously read"
  default 1
  help
    "The maximum number of devices the receiver is connecting to at a time"

  config HERALD_MAX_PAYLOAD_SIZE
  int "Max payload bytes"
  default 256
  help
    "The buffer size to store payloads in. Must be larger then any payload"
  
  config HERALD_DEVICE_EXPIRY_SEC
  int "Max time to remember device after scan (seconds)"
  default 900
  help
    "The maximum amount of time in seconds to remember device before it is removed"
  
  config HERALD_MAX_DEVS_IN_DB
  int "Maximum number of devices to keep in the database"
  default 500
  help
    "The maximum number of devices to keep in the database"
  
  config HERALD_SCAN_EVERYTHING
  bool "Scan for every device"
  default n
  help
    "If set to no, only herald devices will be in didMeasure
    If set to yes, didMeasure will call every device"
  
  config HERALD_FILTER_ALLOW_APPLE_MANUFACTURER_ID
  bool "Allow apple to pass through filter"
  default y
  depends on !HERALD_SCAN_EVERYTHING
  help
    "If set to Y then apple and herald service UUID will pass through filter"
  
  config HERALD_NOT_FOUND_RETRY_S
  int "Time to wait after herald not found"
  default 20
  help
    "The time to wait after a device did not report a herald service"
  
  config HERALD_NOT_FOUND_MULTIPLIER
  int "Herald not found multiplier"
  default 2
  help
    "Every time a herald service is not found we multiply 
    HERALD_NOT_FOUND_RETRY_S by this multiplier
    Set to less then or equal to zero to not use"
  
  config HERALD_NOT_FOUND_EXPONENTIAL
  int "Herald not found exponential multiplier"
  default 2
  help
    "Every time a herald device is not found we wait
    HERALD_NOT_FOUND_RETRY_S ^ HERALD_NOT_FOUND_EXPONENTIAL
    before retrying
    Set to less then or equal to zero to not use"
  
  config HERALD_NOT_FOUND_RESET_COUNT
  int "Herald not found reset count"
  default 10
  help
    "The count to increase herald_not_found until reset to zero
    This is so we make sure we are retrying frequently enough
    Similar to TCP/IP retry intervals
    Set to less then or equal to zero to never reset"

  config HERALD_MAX_DEVICE_IGNORE_TIME_S
  int "Device ignore time (SEC)"
  default 30
  help
    "When A device reaches either HERALD_MAX_CONNECTION_ATTEMPTS or 
    HERALD_MAX_ATTEMPTS_TO_FIND_SERVICE it will be ignored for this amount of time"

endmenu
```

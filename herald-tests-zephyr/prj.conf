## CMakeLists.txt
```
# SPDX-License-Identifier: Apache-2.0

set(CMAKE_VERBOSE_MAKEFILE ON)

set(CMAKE_CXX_STANDARD 17)
set(CMAKE_CXX_STANDARD_REQUIRED ON)
set(CMAKE_CXX_EXTENSIONS ON)

set(NO_BUILD_TYPE_WARNING ON)

# Zephyr build environment variables set here
#set(ENV{BOARD} nrf52840dongle_nrf52840) # nRF52840 USB dongle
#set(ENV{BOARD} nrf52dk_nrf52832) # nRF52832 USB dongle
#set(ENV{BOARD} nrf5340dk_nrf5340_cpuapp) # nRF5340 DK using secure app core
# Detect if already set. If not, default to latest nRF DK board (5340)
if(DEFINED ENV{BOARD})
  message("Using board specified in BOARD variable: $ENV{BOARD}")
else()
  message("No board specified in BOARD variable. Defaulting to nrf5340dk app core")
  set(ENV{BOARD} nrf5340dk_nrf5340_cpuapp) # nRF5340 DK using secure app core
  set(ENV{ARCH} arm)
  message("BOARD variable now set to: $ENV{BOARD}")
endif()

# Specify additional PROJ settings based on build settings
set(BASE_CONFIG ../config/zephyr)
set(OVERLAY_CONFIG
  ${BASE_CONFIG}/base.conf
  ${BASE_CONFIG}/receiver.conf
  ${BASE_CONFIG}/transmitter.conf
)

if($ENV{BOARD} MATCHES .*nrf5340.*)
  set(OVERLAY_CONFIG 
    ${OVERLAY_CONFIG} 
    ${BASE_CONFIG}/nrf5340.conf
  )
elseif($ENV{BOARD} MATCHES .*nrf52840.*)
  set(OVERLAY_CONFIG 
    ${OVERLAY_CONFIG} 
    ${BASE_CONFIG}/nrf52840.conf
  )
  add_definitions(-DHERALD_MEMORYARENA_MAX=4096)
elseif($ENV{BOARD} MATCHES .*nrf52832.*)
  set(OVERLAY_CONFIG 
    ${OVERLAY_CONFIG} 
    ${BASE_CONFIG}/nrf52832.conf
  )
  add_definitions(-DHERALD_MEMORYARENA_MAX=4096)
elseif($ENV{BOARD} MATCHES .*nrf52833.*)
  set(OVERLAY_CONFIG 
    ${OVERLAY_CONFIG} 
    ${BASE_CONFIG}/nrf52833.conf
  )
endif()
if(CMAKE_BUILD_TYPE MATCHES Debug)
  set(OVERLAY_CONFIG 
    ${OVERLAY_CONFIG} 
    ${BASE_CONFIG}/debug.conf
  )
else()
  set(OVERLAY_CONFIG 
    ${OVERLAY_CONFIG} 
    ${BASE_CONFIG}/release.conf
  )
endif()


# Generic Zephyr build command below
cmake_minimum_required(VERSION 3.13.1)
find_package(Zephyr REQUIRED HINTS $ENV{ZEPHYR_BASE})
project(herald-wearable VERSION 1.2.0 LANGUAGES CXX)

# NOTE: Don't include C library as it bloats the binary beyond DFU max load size (i.e. beyond half of the available flash)

set(HERALD_TARGET zephyr)


# WARNING DO NOT USE THE ZEPHYR DEFAULT EXTERNAL PROJECT INCLUDE METHOD
# IT DOES NOT PROVIDE ZEPHYR BUILD SETTINGS CORRECTLY WHEN CROSS COMPILING ON WINDOWS


# Include Herald core library
set(HERALD_BASE ${CMAKE_CURRENT_SOURCE_DIR}/../herald)
include(../herald/herald.cmake) # include sources and headers

message("HERALD HEADERS: ${HERALD_HEADERS}")

include_directories(
  ..
  ../herald/include
)

if(CMAKE_BUILD_TYPE MATCHES Debug)
  add_definitions(-DHERALD_LOG_LEVEL=4 -DCONFIG_APP_LOG_LEVEL=4)
else()
  add_definitions(-DHERALD_LOG_LEVEL=0 -DCONFIG_APP_LOG_LEVEL=0)
endif()
#HERALD_LOG_LEVEL 4 = debug, 3 = info, 2 = warn / errors (Zephyr LOG_WARN), 1 = info contacts log only (Zephyr LOG_ERR)

# gcc arm does not warn about missing defs until runtime
# NOTE: Catch2 uses exceptions, so we enable -fexceptions
# add_compile_options(--no-undefined -ffunction-sections -fdata-sections -s -fno-unaligned-access -fno-exceptions -fno-rtti -Wall -Wextra -Wl,-z,defs,norelro,--strict,--strict_symbols,--gc-sections,--hash-style=gnu)
add_compile_options(--no-undefined -fexceptions -ffunction-sections -fdata-sections -s -Wl,-z,defs,norelro,--strict,--strict_symbols,--gc-sections,--hash-style=gnu)

target_sources(app PRIVATE
  ${HERALD_SOURCES}
  ${HERALD_SOURCES_ZEPHYR}
  # Simple Payload - Choose ONE
  # Option 1: MBED TLS
  #${HERALD_SOURCES_MBEDTLS}
  # Option 2: TinyCrypt
  ${HERALD_SOURCES_TINYCRYPT}

  # For testing basic catch2 settings:-
  src/dummy-tests.cpp

  # Now tests source
  # root with main
	# ../herald-tests/bytearrayprinter-tests.cpp
	#../herald-tests/datatypes-tests.cpp # Passes when split out on 21 Mar 2021
	#../herald-tests/datetime-tests.cpp # Passes when split out on 21 Mar 2021
	#../herald-tests/randomuuid-tests.cpp # FAILS silently 21 Mar 2021
	
	# Low level
	#../herald-tests/sensorlogger-tests.cpp # Passes on its own 21 Mar 2021
	#../herald-tests/data-tests.cpp # Passes on its own 21 Mar 2021
	#../herald-tests/datatypesdataderived-tests.cpp # Passes on its own 21 Mar 2021
  # These three passed together on 21 Mar 2021
	#../herald-tests/errorcontactlog-tests.cpp
	# ../herald-tests/blemacaddress-tests.cpp
	#../herald-tests/targetidentifier-tests.cpp

  # mid level
	#../herald-tests/analysisrunner-tests.cpp # Passes on its own 21 Mar 2021
	#../herald-tests/analysissensor-tests.cpp # Passes on its own 21 Mar 2021
  # These three passed together on 21 Mar 2021
	#../herald-tests/beaconpayload-tests.cpp
	#../herald-tests/extendeddata-tests.cpp
	#../herald-tests/fixedpayload-tests.cpp
	#../herald-tests/simplepayload-tests.cpp # Passes on its own 21 Mar 2021
	#../herald-tests/bledevice-tests.cpp # SILENTLY FAILS on its own 21 Mar 2021
	#../herald-tests/sample-tests.cpp # Passes on its own 21 Mar 2021 (May require hci reflash too)
	#../herald-tests/ranges-tests.cpp # FAILS on its own 21 Mar 2021 - Breaks the programmer! Also hard faults.

  # high level
  # These four passed together on 21 Mar 2021
	#../herald-tests/advertparser-tests.cpp
	#../herald-tests/bledatabase-tests.cpp
	#../herald-tests/blecoordinator-tests.cpp
	#../herald-tests/coordinator-tests.cpp

  # SHA-256 and simple payload specific
  # The following tests passed together with zephyronly tests included as of 08 July 2021 21:27+0100
  # ../herald-tests/data-tests.cpp
  # ../herald-tests/sha256-tests.cpp
  # ../herald-tests/simplepayload-tests.cpp

  # NOTE: All tests that passed individually on 21 Mar 2021 also passed all together in 15 seconds
  #       This means that the issue is the individual tests, not catch or zephyr specifically, and not RAM issues.
  #       All together they used 707KB on Flash for the merged.hex file on a nRF5340dk build done on Windows 10.

  # now main func
  src/main.cpp
)
```

## prj.conf
```kconfig
# Wearable specific settings (see config/zephyr/base.conf et al for mixed-in settings)
CONFIG_BT_DEVICE_NAME="Herald Zephyr Tests"

CONFIG_MAIN_STACK_SIZE=32768

CONFIG_EXCEPTIONS=y
# ^ Exceptions required for catch library to work

# Zephyr activities run on main stack, workqueue used for async and long running work
CONFIG_SYSTEM_WORKQUEUE_STACK_SIZE=4096

# Memory protection
# CONFIG_THREAD_STACK_INFO=n
CONFIG_THREAD_CUSTOM_DATA=n
CONFIG_FPU=n

# Boot
CONFIG_BOOT_BANNER=n
CONFIG_BOOT_DELAY=0

# Micro tuning of stack sizes from thread analyzer
CONFIG_IDLE_STACK_SIZE=256
```

## src/main.cpp
```c
/*
 * SPDX-License-Identifier: Apache-2.0
 */

#include <zephyr/types.h>
#include <stddef.h>
#include <string.h>
#include <errno.h>
#include <sys/printk.h>
#include <sys/byteorder.h>
#include <zephyr.h>

#include <kernel_structs.h>
// #include <sys/thread_stack.h> // Cannot be found in NCS v1.6.0
// #include <drivers/gpio.h>
// #include <drivers/hwinfo.h>

#include <logging/log.h>
LOG_MODULE_REGISTER(app, CONFIG_APP_LOG_LEVEL);

// See https://github.com/catchorg/Catch2/blob/devel/docs/own-main.md#top
#define CATCH_CONFIG_RUNNER
#define SA_ONSTACK 0
#define CATCH_CONFIG_NO_POSIX_SIGNALS 
#define CATCH_CONFIG_NOSTDOUT
// #define CATCH_CONFIG_DISABLE_EXCEPTIONS
#include "../../herald-tests/catch.hpp"

#include <sstream>
#include <cstdio>

struct k_thread herald_thread;
constexpr int stackMaxSize = 
// #ifdef CONFIG_BT_MAX_CONN
// 	2048 + (CONFIG_BT_MAX_CONN * 512)
// 	// Was 12288 + (CONFIG_BT_MAX_CONN * 512), but this starved newlibc of HEAP (used in handling BLE connections/devices)
// #else
// 	9192
// #endif
// // Since v2.1 - MEMORY ARENA extra stack reservation - See herald/datatype/data.h
// #ifdef HERALD_MEMORYARENA_MAX
//   + HERALD_MEMORYARENA_MAX
// #else
//   + 8192
// #endif
//   + 4508 // Since v2.1 test for debug
//   // + 5120 // Since v2.1 AllocatableArray and removal of vector and map
// 	// Note +0 crashes at Herald entry, +1024 crashes at PAST DATE, +2048 crashes at creating sensor array
// 	// +3072 crashes at herald entry with Illegal load of EXC_RETURN into PC
// 	// +4096 crashes at BEFORE DATE          with  Stacking error (context area might be not valid)... Data Access Violation... MMFAR Address: 0x20006304
// 	// +5120 crashes at sensor array running with  Stacking error (context area might be not valid)... Data Access Violation... MMFAR Address: 0x20008ae0
// 	// +6144 crashes at sensor array running with  Stacking error (context area might be not valid)... Data Access Violation... MMFAR Address: 0x20008ee0
// 	// +7168 crashes at sensor array running with  Stacking error (context area might be not valid)... Data Access Violation... MMFAR Address: 0x200092e0
// 	// +8192 crashes at sensor array running with  Stacking error (context area might be not valid)... Data Access Violation... MMFAR Address: 0x200096e0
// 	// +9216 crashes at sensor array running with  Stacking error (context area might be not valid)... Data Access Violation... MMFAR Address: 0x20009ae0
// 	// +10240 crashes zephyr in main thread loop - likely due to memory exhaustion for the heap (over 96% SRAM used at this level)
// 	// Changed heap for nRF52832 to 1024, max conns to 4 from 2
// 	// +0 crashes BEFORE DATE with Stacking error (context area might be not valid)... Data Access Violation... MMFAR Address: 0x20006504
// 	// Changed heap for nRF52832 to 2048. max conns back to 2
// 	// +4096 crashes BEFORE DATE with Stacking error (context area might be not valid)... Data Access Violation... MMFAR Address: 0x20006904
// 	// +5120 crashes at sensor array running with  Stacking error (context area might be not valid)... Data Access Violation... MMFAR Address: 0x200090e0

// // Additions for catch2
//   // + 16384

// ;
65536;
K_THREAD_STACK_DEFINE(herald_stack, stackMaxSize);

// Catch normally uses std::cout but Zephyr doesn't use that - so we need this:-
// from https://github.com/catchorg/Catch2/issues/1290

class out_buff : public std::stringbuf {
    std::FILE* m_stream;
public:
    out_buff(std::FILE* stream):m_stream(stream) {}
    ~out_buff();
    int sync() override {
        int ret = 0;
        // for (unsigned char c : str()) {
        //     if (putc(c, m_stream) == EOF) {
        //         ret = -1;
        //         break;
        //     }
        // }
        LOG_ERR("Catch2: %s",log_strdup(str().c_str()));
        // Reset the buffer to avoid printing it multiple times
        str("");
        return ret;
    }
};

out_buff::~out_buff() { pubsync(); }

#if defined(__clang__)
#pragma clang diagnostic ignored "-Wexit-time-destructors" // static variables in cout/cerr/clog
#endif

namespace Catch {
    std::ostream& cout() {
        static std::ostream ret(new out_buff(stdout));
        return ret;
    }
    std::ostream& clog() {
        static std::ostream ret(new out_buff(stderr));
        return ret;
    }
    std::ostream& cerr() {
        return clog();
    }
}

// Fatal thread failure error handler in Zephyr
void k_sys_fatal_error_handler(unsigned int reason, const z_arch_esf_t *esf) {
  LOG_DBG("Kernel fatal thread failure with reason: %d", reason);
  // Always return to allow main thread to proceed (Don't halt via k_fatal_halt like the default)
}

void _exit(int status)
{
  LOG_ERR("FAILURE: exit called with status %d", status);
  while (1) {
    k_sleep(K_SECONDS(10));
  }
}

void herald_entry() {
  LOG_DBG("Catch thread entry");
  k_sleep(K_SECONDS(10));
  try {
    LOG_DBG("In try");
    k_sleep(K_SECONDS(10));
    Catch::Session session; 
    LOG_DBG("Session created. Calling run in 2 seconds");
    k_sleep(K_SECONDS(10));
    int result = session.run();
    LOG_DBG("Catch returned a value of: %d",result);
  } catch (const std::exception& e) {
    LOG_ERR("Tests reported problem: %s",log_strdup(e.what()));
  }

	while (1) {
		k_sleep(K_SECONDS(2));

		LOG_DBG("test thread still running");
	}
}

void main(void)
{
	int nameOk = k_thread_name_set(NULL,"main");
  // Wait for a few seconds for remote to connect
  LOG_DBG("Waiting for 10 seconds for tests to start (so we see thread analyser output)");
  k_sleep(K_SECONDS(10));

  // Now manually initialise catch
  LOG_DBG("Initialising catch");
  k_sleep(K_SECONDS(10));

  [[maybe_unused]]
	k_tid_t herald_pid = k_thread_create(&herald_thread, herald_stack, stackMaxSize,
			(k_thread_entry_t)herald_entry, NULL, NULL, NULL,
			-1, K_USER,
			K_SECONDS(2));
	nameOk = k_thread_name_set(herald_pid,"herald");
      
  LOG_DBG("Catch thread started");

	while (1) {
		k_sleep(K_SECONDS(2));

		LOG_DBG("main thread still running");
	}
}
```

## src/dummy-tests.cpp
```c
//  Copyright 2021 Herald Project Contributors
//  SPDX-License-Identifier: Apache-2.0
//

#include "../../herald-tests/catch.hpp"

TEST_CASE("dummy", "[dummy]") {
  SECTION("dummy") {
    REQUIRE(1 == (2 / 2));
  }
}
```
